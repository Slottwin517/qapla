// handgpt.h — char-level transformer: forward + backward by hand, in C.
//
// Qapla' — a char-level transformer trained from scratch on an ESP32-S3.
//
// Code generated by AI (Claude) under the direction of Carlos López Andrés
// (Codix Labs): concept, architecture, decisions and validation are the
// author's; the implementation was generated by the AI.
// Backprop derived by hand (no autograd), gradient-checked against a
// PyTorch reference and validated in QEMU (xtensa) before hardware.
//
// License: Apache 2.0.
//
// This single header contains the whole model: the weight struct, the
// activation cache, weight init, LayerNorm (fwd/bwd), the forward pass
// (embeddings -> attention -> FFN -> tied-weight logits -> cross-entropy)
// and the full hand-derived backward pass. No framework, no autograd.
#pragma once
#include <math.h>
#include <string.h>

#ifndef NV
#define NV 32
#endif
#ifndef NC
#define NC 160
#endif
#ifndef NT
#define NT 32
#endif
#define NF (4*NC)
// float on the chip; define HANDGPT_DOUBLE to build the gradient check
// in double precision on a PC (see tests/). Firmware behaviour is unchanged.
#ifdef HANDGPT_DOUBLE
typedef double real;
#else
typedef float real;
#endif

typedef struct {
  real Wte[NV*NC], Wpe[NT*NC];
  real g1[NC], b1[NC];
  real Wq[NC*NC], Wk[NC*NC], Wv[NC*NC], Wo[NC*NC];
  real g2[NC], b2[NC];
  real W1[NC*NF], bf1[NF];
  real W2[NF*NC], bf2[NC];
  real gf[NC], bf[NC];
} Model;

#ifdef HANDGPT_DOUBLE
#define EXPF exp
#define SQRTF sqrt
#define LOGF log
#else
#define EXPF expf
#define SQRTF sqrtf
#define LOGF logf
#endif

typedef struct {
  int X[NT], Y[NT];
  real h0[NT*NC];
  real xn1[NT*NC], inv1[NT];
  real q[NT*NC], k[NT*NC], v[NT*NC];
  real A[NT*NT], ao[NT*NC];
  real h1[NT*NC];
  real xn2[NT*NC], inv2[NT];
  real f1[NT*NF], fa[NT*NF];
  real h2[NT*NC];
  real xnf[NT*NC], invf[NT];
  real logits[NT*NV], P[NT*NV];
} Cache;

static real frand(unsigned int *s, real sc){
  *s ^= *s<<13; *s ^= *s>>17; *s ^= *s<<5;
  real u1=((*s>>8)&0xFFFFFF)/16777216.0;
  *s ^= *s<<13; *s ^= *s>>17; *s ^= *s<<5;
  real u2=((*s>>8)&0xFFFFFF)/16777216.0;
  if(u1<1e-7) u1=1e-7;
  return (real)(SQRTF(-2.0*LOGF(u1))*cos(6.2831853*u2))*sc;
}

void model_init(Model*m, unsigned int seed){
  unsigned int s=seed?seed:1;
  memset(m,0,sizeof(*m));
  for(int i=0;i<NV*NC;i++) m->Wte[i]=frand(&s,0.02);
  for(int i=0;i<NT*NC;i++) m->Wpe[i]=frand(&s,0.02);
  for(int i=0;i<NC;i++){m->g1[i]=1;m->g2[i]=1;m->gf[i]=1;}
  real sc=1.0/SQRTF((real)NC);
  for(int i=0;i<NC*NC;i++){m->Wq[i]=frand(&s,sc);m->Wk[i]=frand(&s,sc);m->Wv[i]=frand(&s,sc);m->Wo[i]=frand(&s,sc);}
  for(int i=0;i<NC*NF;i++) m->W1[i]=frand(&s,sc);
  real sc2=1.0/SQRTF((real)NF);
  for(int i=0;i<NF*NC;i++) m->W2[i]=frand(&s,sc2);
}

static void ln_fwd(const real*x,const real*g,const real*b,real*y,real*xn,real*inv){
  real mu=0; for(int i=0;i<NC;i++) mu+=x[i]; mu/=NC;
  real var=0; for(int i=0;i<NC;i++){real d=x[i]-mu; var+=d*d;} var/=NC;
  real iv=1.0/SQRTF(var+1e-5); *inv=iv;
  for(int i=0;i<NC;i++){ xn[i]=(x[i]-mu)*iv; y[i]=xn[i]*g[i]+b[i]; }
}
static void ln_bwd(const real*dy,const real*xn,real inv,const real*g,real*dx,real*dg,real*db){
  real m1=0,m2=0;
  for(int i=0;i<NC;i++){ real dxn=dy[i]*g[i]; m1+=dxn; m2+=dxn*xn[i]; dg[i]+=dy[i]*xn[i]; db[i]+=dy[i]; }
  m1/=NC; m2/=NC;
  for(int i=0;i<NC;i++){ real dxn=dy[i]*g[i]; dx[i]=inv*(dxn-m1-xn[i]*m2); }
}

// ===== FORWARD PASS =====
// embeddings + positions -> LN -> causal single-head attention (+residual)
// -> LN -> ReLU FFN (+residual) -> final LN -> logits (tied to Wte) -> CE loss.
real forward(Model*m, Cache*c, const int*X, const int*Y){
  memcpy(c->X,X,sizeof(int)*NT);
  for(int t=0;t<NT;t++) for(int i=0;i<NC;i++) c->h0[t*NC+i]=m->Wte[X[t]*NC+i]+m->Wpe[t*NC+i];
  for(int t=0;t<NT;t++){ real y[NC]; ln_fwd(&c->h0[t*NC],m->g1,m->b1,y,&c->xn1[t*NC],&c->inv1[t]);
    for(int j=0;j<NC;j++){ real aq=0,ak=0,av=0; for(int i=0;i<NC;i++){aq+=y[i]*m->Wq[i*NC+j];ak+=y[i]*m->Wk[i*NC+j];av+=y[i]*m->Wv[i*NC+j];}
      c->q[t*NC+j]=aq;c->k[t*NC+j]=ak;c->v[t*NC+j]=av; } }
  real isc=1.0/SQRTF((real)NC);
  for(int t=0;t<NT;t++){
    real*Arow=&c->A[t*NT]; real mx=-1e30;
    for(int u=0;u<=t;u++){ real sc=0; for(int i=0;i<NC;i++) sc+=c->q[t*NC+i]*c->k[u*NC+i]; sc*=isc; Arow[u]=sc; if(sc>mx)mx=sc; }
    real sum=0; for(int u=0;u<=t;u++){ Arow[u]=EXPF(Arow[u]-mx); sum+=Arow[u]; }
    for(int u=0;u<=t;u++) Arow[u]/=sum; for(int u=t+1;u<NT;u++) Arow[u]=0;
    for(int i=0;i<NC;i++){ real a=0; for(int u=0;u<=t;u++) a+=Arow[u]*c->v[u*NC+i]; c->ao[t*NC+i]=a; }
  }
  for(int t=0;t<NT;t++) for(int j=0;j<NC;j++){ real a=0; for(int i=0;i<NC;i++) a+=c->ao[t*NC+i]*m->Wo[i*NC+j]; c->h1[t*NC+j]=c->h0[t*NC+j]+a; }
  for(int t=0;t<NT;t++){ real y[NC]; ln_fwd(&c->h1[t*NC],m->g2,m->b2,y,&c->xn2[t*NC],&c->inv2[t]);
    for(int j=0;j<NF;j++){ real a=m->bf1[j]; for(int i=0;i<NC;i++) a+=y[i]*m->W1[i*NF+j]; c->f1[t*NF+j]=a; c->fa[t*NF+j]=a>0?a:0; }
    for(int j=0;j<NC;j++){ real a=m->bf2[j]; for(int i=0;i<NF;i++) a+=c->fa[t*NF+i]*m->W2[i*NC+j]; c->h2[t*NC+j]=c->h1[t*NC+j]+a; }
  }
  real loss=0;
  for(int t=0;t<NT;t++){ real y[NC]; ln_fwd(&c->h2[t*NC],m->gf,m->bf,y,&c->xnf[t*NC],&c->invf[t]);
    real mx=-1e30;
    for(int vv=0;vv<NV;vv++){ real a=0; for(int i=0;i<NC;i++) a+=y[i]*m->Wte[vv*NC+i]; c->logits[t*NV+vv]=a; if(a>mx)mx=a; }
    real sum=0; for(int vv=0;vv<NV;vv++){ c->P[t*NV+vv]=EXPF(c->logits[t*NV+vv]-mx); sum+=c->P[t*NV+vv]; }
    for(int vv=0;vv<NV;vv++) c->P[t*NV+vv]/=sum;
    if(Y){ c->Y[t]=Y[t]; real p=c->P[t*NV+Y[t]]; if(p<1e-9)p=1e-9; loss+=-LOGF(p); }
  }
  return Y? loss/NT : 0;
}

static real dh0[NT*NC],dh1[NT*NC],dh2[NT*NC];
static real dq[NT*NC],dk[NT*NC],dv[NT*NC],dao[NT*NC],dA[NT*NT];
static real dln1[NT*NC],dln2[NT*NC];

// ===== BACKWARD PASS (hand-derived, no autograd) =====
// Reverse of forward: CE+softmax grad -> tied logits -> final LN -> FFN
// -> LN -> attention (softmax + QK/V) -> LN -> back into the embeddings.
// Every gradient is written out explicitly; this is the heart of the project.
void backward(Model*m, Cache*c, Model*g){
  memset(dh0,0,sizeof(dh0)); memset(dh1,0,sizeof(dh1));
  memset(dq,0,sizeof(dq)); memset(dk,0,sizeof(dk)); memset(dv,0,sizeof(dv));
  for(int t=0;t<NT;t++){
    real dlog[NV];
    for(int vv=0;vv<NV;vv++) dlog[vv]=c->P[t*NV+vv]/NT;
    dlog[c->Y[t]]-=1.0/NT;
    real ylnf[NC]; for(int i=0;i<NC;i++) ylnf[i]=c->xnf[t*NC+i]*m->gf[i]+m->bf[i];
    real dy[NC]; for(int i=0;i<NC;i++) dy[i]=0;
    for(int vv=0;vv<NV;vv++){ for(int i=0;i<NC;i++){ g->Wte[vv*NC+i]+=dlog[vv]*ylnf[i]; dy[i]+=dlog[vv]*m->Wte[vv*NC+i]; } }
    ln_bwd(dy,&c->xnf[t*NC],c->invf[t],m->gf,&dh2[t*NC],g->gf,g->bf);
  }
  for(int t=0;t<NT;t++){
    for(int i=0;i<NC;i++) dh1[t*NC+i]+=dh2[t*NC+i];
    real*df2=&dh2[t*NC];
    real dfa[NF];
    for(int i=0;i<NF;i++){ real a=0; for(int j=0;j<NC;j++){ g->W2[i*NC+j]+=c->fa[t*NF+i]*df2[j]; a+=df2[j]*m->W2[i*NC+j]; } dfa[i]=a; }
    for(int j=0;j<NC;j++) g->bf2[j]+=df2[j];
    real df1[NF]; for(int i=0;i<NF;i++) df1[i]=c->f1[t*NF+i]>0?dfa[i]:0;
    real yln2[NC]; for(int i=0;i<NC;i++) yln2[i]=c->xn2[t*NC+i]*m->g2[i]+m->b2[i];
    real dln2y[NC]; for(int i=0;i<NC;i++) dln2y[i]=0;
    for(int i=0;i<NC;i++){ for(int j=0;j<NF;j++){ g->W1[i*NF+j]+=yln2[i]*df1[j]; dln2y[i]+=df1[j]*m->W1[i*NF+j]; } }
    for(int j=0;j<NF;j++) g->bf1[j]+=df1[j];
    real dh1b[NC];
    ln_bwd(dln2y,&c->xn2[t*NC],c->inv2[t],m->g2,dh1b,g->g2,g->b2);
    for(int i=0;i<NC;i++) dh1[t*NC+i]+=dh1b[i];
  }
  memset(dao,0,sizeof(dao));
  for(int t=0;t<NT;t++){
    for(int i=0;i<NC;i++) dh0[t*NC+i]+=dh1[t*NC+i];
    real*dap=&dh1[t*NC];
    for(int i=0;i<NC;i++){ for(int j=0;j<NC;j++){ g->Wo[i*NC+j]+=c->ao[t*NC+i]*dap[j]; dao[t*NC+i]+=dap[j]*m->Wo[i*NC+j]; } }
  }
  memset(dA,0,sizeof(dA));
  for(int t=0;t<NT;t++){
    for(int u=0;u<=t;u++){ real s=0; for(int i=0;i<NC;i++) s+=dao[t*NC+i]*c->v[u*NC+i]; dA[t*NT+u]=s; }
    for(int u=0;u<=t;u++){ for(int i=0;i<NC;i++) dv[u*NC+i]+=c->A[t*NT+u]*dao[t*NC+i]; }
  }
  real isc=1.0/SQRTF((real)NC);
  for(int t=0;t<NT;t++){
    real dot=0; for(int u=0;u<=t;u++) dot+=dA[t*NT+u]*c->A[t*NT+u];
    real dscore[NT];
    for(int u=0;u<=t;u++) dscore[u]=c->A[t*NT+u]*(dA[t*NT+u]-dot)*isc;
    for(int u=0;u<=t;u++){ for(int i=0;i<NC;i++){ dq[t*NC+i]+=dscore[u]*c->k[u*NC+i]; dk[u*NC+i]+=dscore[u]*c->q[t*NC+i]; } }
  }
  memset(dln1,0,sizeof(dln1));
  for(int t=0;t<NT;t++){
    real yln1[NC]; for(int i=0;i<NC;i++) yln1[i]=c->xn1[t*NC+i]*m->g1[i]+m->b1[i];
    for(int i=0;i<NC;i++){ for(int j=0;j<NC;j++){
      g->Wq[i*NC+j]+=yln1[i]*dq[t*NC+j]; g->Wk[i*NC+j]+=yln1[i]*dk[t*NC+j]; g->Wv[i*NC+j]+=yln1[i]*dv[t*NC+j];
      dln1[t*NC+i]+=dq[t*NC+j]*m->Wq[i*NC+j]+dk[t*NC+j]*m->Wk[i*NC+j]+dv[t*NC+j]*m->Wv[i*NC+j];
    } }
    real dh0b[NC];
    ln_bwd(&dln1[t*NC],&c->xn1[t*NC],c->inv1[t],m->g1,dh0b,g->g1,g->b1);
    for(int i=0;i<NC;i++) dh0[t*NC+i]+=dh0b[i];
  }
  for(int t=0;t<NT;t++){ for(int i=0;i<NC;i++){ g->Wte[c->X[t]*NC+i]+=dh0[t*NC+i]; g->Wpe[t*NC+i]+=dh0[t*NC+i]; } }
}

#define NPAR (int)(sizeof(Model)/sizeof(real))
