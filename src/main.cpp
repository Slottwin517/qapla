// main.cpp — Qapla' firmware for the ESP32-S3.
//
// Trains the char-level transformer (see handgpt.h) FROM SCRATCH on-chip:
// random init -> forward -> cross-entropy -> hand-written backward -> SGD
// with momentum + cosine LR. Shows live loss on an SH1106 OLED, checkpoints
// the best model to flash (LittleFS), and on next boot loads it and generates.
//
// Code generated by AI (Claude) under the direction of Carlos López Andrés
// (Codix Labs). License: Apache 2.0.
//
// Note: user-facing Serial/OLED strings are in Spanish (the author's voice).
#include <Arduino.h>
#include <U8g2lib.h>
#include <Wire.h>
#include <LittleFS.h>
#include "handgpt.h"
#include "corpus_klingon.h"

#define FORCE_RETRAIN 0
#define BATCH        8
#define TOTAL_STEPS  5000
#define WARMUP       100
#define BASE_LR      0.02f
#define BETA         0.9f
#define MA_ALPHA     0.02f
#define CKPT_EVERY   500
#define MODEL_PATH   "/model.bin"
#define GEN_LEN      220
#define GEN_TEMP     0.85f

U8G2_SH1106_128X64_NONAME_F_HW_I2C u8g2(U8G2_R0, U8X8_PIN_NONE);
bool oled_ok=false;
Model *M=nullptr, *G=nullptr, *BEST=nullptr;
Cache *CA=nullptr;
static uint8_t *DATA=nullptr;
static float   *VEL=nullptr;
int NDATA=0, V=0;
char ITOS[NV];
int STOI[256];
unsigned int rng=1701;
#define RND (rng^=rng<<13,rng^=rng>>17,rng^=rng<<5,rng)

float lr_at(int step){
  if(step<WARMUP) return BASE_LR*(float)step/(float)WARMUP;
  float p=(float)(step-WARMUP)/(float)(TOTAL_STEPS-WARMUP); if(p>1.0f)p=1.0f;
  return BASE_LR*(0.05f+0.95f*0.5f*(1.0f+cosf(3.14159265f*p)));
}
void oled_msg(const char*a,const char*b){
  if(!oled_ok)return; u8g2.clearBuffer(); u8g2.setFont(u8g2_font_6x10_tf);
  u8g2.drawStr(0,12,a); if(b)u8g2.drawStr(0,28,b); u8g2.sendBuffer();
}
void oled_train(int step,float loss,float ma){
  if(!oled_ok)return; char b[26];
  u8g2.clearBuffer(); u8g2.setFont(u8g2_font_6x10_tf);
  u8g2.drawStr(0,10,"KlinGPT 319K on S3");
  snprintf(b,sizeof(b),"step %d",step); u8g2.drawStr(0,26,b);
  snprintf(b,sizeof(b),"loss %.3f ma %.3f",loss,ma); u8g2.drawStr(0,40,b);
  int w=(int)(120.0f*step/TOTAL_STEPS); if(w<0)w=0; if(w>120)w=120;
  u8g2.drawFrame(0,50,122,10); u8g2.drawBox(1,51,w,8); u8g2.sendBuffer();
}
void oled_gen(const char*full,int len){
  if(!oled_ok)return; u8g2.clearBuffer(); u8g2.setFont(u8g2_font_6x10_tf);
  u8g2.drawStr(0,10,"KlinGPT dice:");
  int per=21,start=len-per*4; if(start<0)start=0;
  for(int row=0;row<4;row++){ char line[22]; int n=0;
    for(int i=start+row*per;i<start+(row+1)*per && i<len;i++){ char c=full[i]; if(c=='\n')c=' '; line[n++]=c; }
    line[n]=0; u8g2.drawStr(0,24+row*10,line);
  } u8g2.sendBuffer();
}
void build_vocab(){
  for(int i=0;i<256;i++)STOI[i]=-1; V=0;
  for(int i=0;i<KLIN_CORPUS_LEN;i++){ unsigned char ch=(unsigned char)KLIN_CORPUS[i];
    if(STOI[ch]<0){ STOI[ch]=V; if(V<NV)ITOS[V]=(char)ch; V++; } }
}
// file format: [float loss][raw model bytes]
bool save_model(Model*m,float loss){
  File f=LittleFS.open(MODEL_PATH,"w"); if(!f)return false;
  f.write((uint8_t*)&loss,sizeof(float));
  const uint8_t*p=(const uint8_t*)m; size_t left=sizeof(Model);
  while(left){ size_t c=left>4096?4096:left; if(f.write(p,c)!=c){f.close();return false;} p+=c; left-=c; }
  f.close(); return true;
}
bool load_model(Model*m,float*loss){
  if(!LittleFS.exists(MODEL_PATH))return false;
  File f=LittleFS.open(MODEL_PATH,"r"); if(!f)return false;
  if(f.read((uint8_t*)loss,sizeof(float))!=(int)sizeof(float)){f.close();return false;}
  uint8_t*p=(uint8_t*)m; size_t left=sizeof(Model);
  while(left){ size_t c=left>4096?4096:left; if(f.read(p,c)!=(int)c){f.close();return false;} p+=c; left-=c; }
  f.close(); return true;
}
int sample_next(real*logits,float temp){
  float mx=-1e30f; for(int v=0;v<NV;v++) if(logits[v]>mx)mx=logits[v];
  float sum=0,p[NV];
  for(int v=0;v<NV;v++){ p[v]=expf((logits[v]-mx)/temp); sum+=p[v]; }
  float r=((float)(RND%100000)/100000.0f)*sum,acc=0;
  for(int v=0;v<NV;v++){ acc+=p[v]; if(r<=acc)return v; }
  return NV-1;
}
void generate(int n){
  int ctx[NT]; int nl=STOI[(int)'\n']>=0?STOI[(int)'\n']:0;
  for(int i=0;i<NT;i++)ctx[i]=nl;
  static char gbuf[512]; int gl=0; int Xd[NT],Yd[NT];
  for(int k=0;k<n;k++){
    for(int i=0;i<NT;i++){Xd[i]=ctx[i];Yd[i]=ctx[i];}
    forward(M,CA,Xd,Yd);
    int tk=sample_next(&CA->logits[(NT-1)*NV],GEN_TEMP);
    char c=ITOS[tk]; Serial.print(c); if(gl<500)gbuf[gl++]=c;
    if(k%3==0)oled_gen(gbuf,gl);
    for(int i=0;i<NT-1;i++)ctx[i]=ctx[i+1]; ctx[NT-1]=tk;
  }
  Serial.println(); oled_gen(gbuf,gl);
}
void genTask(void*pv){
  Serial.println("=== KlinGPT: MODO GENERACION ===");
  while(1){ Serial.println("\nKlinGPT dice:"); generate(GEN_LEN); delay(4000); }
}
void trainTask(void*pv){
  DATA=(uint8_t*)ps_malloc(KLIN_CORPUS_LEN);
  G=(Model*)ps_malloc(sizeof(Model));
  VEL=(float*)ps_malloc((size_t)NPAR*sizeof(float));
  BEST=(Model*)ps_malloc(sizeof(Model));
  if(!DATA||!G||!VEL||!BEST){ Serial.println("FALLO ps_malloc"); oled_msg("FALLO","memoria"); vTaskDelete(NULL); return; }
  for(int i=0;i<KLIN_CORPUS_LEN;i++)DATA[i]=(uint8_t)STOI[(unsigned char)KLIN_CORPUS[i]];
  NDATA=KLIN_CORPUS_LEN;
  memset(VEL,0,(size_t)NPAR*sizeof(float));
  model_init(M,1701);
  Serial.printf("params=%d C=%d T=%d V=%d batch=%d pasos=%d (cosine)\n",NPAR,NC,NT,V,BATCH,TOTAL_STEPS);
  Serial.println("--- entrenando (loss | ma | lr | ms) ---");
  float ma=-1,best_ma=1e30f;
  float*mp=(float*)M,*gp=(float*)G,invb=1.0f/BATCH;
  unsigned long t_all=millis();
  for(int step=0; step<=TOTAL_STEPS; step++){
    unsigned long t0=millis(); memset(G,0,sizeof(Model)); float tot=0;
    for(int b=0;b<BATCH;b++){
      int start=RND%(NDATA-NT-1),X[NT],Y[NT];
      for(int t=0;t<NT;t++){X[t]=DATA[start+t];Y[t]=DATA[start+t+1];}
      tot+=forward(M,CA,X,Y); backward(M,CA,G);
    }
    float loss=tot/BATCH;
    if(loss!=loss||loss>1e30f){ Serial.printf("!! loss no finito en %d\n",step); break; }
    float lr=lr_at(step);
    for(int i=0;i<NPAR;i++){ float gg=gp[i]*invb; VEL[i]=BETA*VEL[i]+gg; mp[i]-=lr*VEL[i]; }
    if(ma<0)ma=loss; else ma=(1.0f-MA_ALPHA)*ma+MA_ALPHA*loss;
    if(ma<best_ma){ best_ma=ma; memcpy(BEST,M,sizeof(Model)); }
    if(step>0 && step%CKPT_EVERY==0){ if(save_model(BEST,best_ma))Serial.printf("  [checkpoint step %d, best ma %.4f]\n",step,best_ma); }
    unsigned long dt=millis()-t0;
    oled_train(step,loss,ma);
    if(step%20==0)Serial.printf(" step %5d | loss %.4f | ma %.4f | lr %.4f | %lu ms\n",step,loss,ma,lr,dt);
  }
  save_model(BEST,best_ma);
  Serial.printf("=== FIN. best ma=%.4f en %lu s. Guardado con loss en flash. ===\n",best_ma,(millis()-t_all)/1000);
  oled_msg("FIN entreno","Generando...");
  float lf=0; load_model(M,&lf);
  Serial.printf("Modelo recargado de flash (loss guardado=%.4f). KlinGPT dice:\n",lf);
  generate(GEN_LEN);
  Serial.println("El cerebro vive en el chip. Desenchufa y sigue -- de verdad.");
  vTaskDelete(NULL);
}
void setup(){
  Serial.begin(115200); delay(1800); Serial.println();
  Serial.println("=== KlinGPT v4: 319K params, corpus v2, cosine, persiste loss ===");
  Wire.begin(8,9); oled_ok=u8g2.begin(); oled_msg("KlinGPT v4","arrancando...");
  if(!LittleFS.begin(true)) Serial.println("LittleFS FALLO");
#if FORCE_RETRAIN
  LittleFS.remove(MODEL_PATH); Serial.println("FORCE_RETRAIN: modelo borrado.");
#endif
  build_vocab(); Serial.printf("vocab=%d (NV=%d)\n",V,NV);
  M=(Model*)ps_malloc(sizeof(Model)); CA=(Cache*)ps_malloc(sizeof(Cache));
  if(!M||!CA){ Serial.println("FALLO ps_malloc M/CA"); oled_msg("FALLO","memoria"); return; }
  Serial.printf("PSRAM libre: %u KB\n",(unsigned)(ESP.getFreePsram()/1024));
  float lf=0;
  if(LittleFS.exists(MODEL_PATH) && load_model(M,&lf)){
    Serial.printf("Modelo en flash (loss=%.4f) -> MODO GENERACION\n",lf);
    char b[26]; snprintf(b,sizeof(b),"loss %.3f",lf); oled_msg("Modelo cargado",b);
    xTaskCreatePinnedToCore(genTask,"gen",32768,NULL,1,NULL,1);
  }else{
    Serial.println("Sin modelo -> ENTRENANDO desde cero");
    xTaskCreatePinnedToCore(trainTask,"train",32768,NULL,1,NULL,1);
  }
}
void loop(){ delay(1000); }